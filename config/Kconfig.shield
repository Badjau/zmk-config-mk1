## config/boards/shields/mk1/Kconfig.defconfig
```kconfig
if SHIELD_MK1

config ZMK_KEYBOARD_NAME
    default "mk1"

if ZMK_DISPLAY

config I2C
    default y

config SSD1306
    default y

endif # ZMK_DISPLAY

endif
```

## config/boards/shields/mk1/Kconfig.shield
```kconfig
config SHIELD_MK1_LEFT
    def_bool $(shields_list_contains,mk1_left)

config SHIELD_MK1_RIGHT
    def_bool $(shields_list_contains,mk1_right)
```

## config/boards/shields/nice_oled/Kconfig.defconfig
```kconfig
if SHIELD_NICE_OLED

config LV_Z_VDB_SIZE
    default 64
    # default 100

config LV_DPI_DEF
    default 148
    # default 161

config LV_Z_BITS_PER_PIXEL
    default 1

choice LV_COLOR_DEPTH
    default LV_COLOR_DEPTH_1
endchoice

choice ZMK_DISPLAY_WORK_QUEUE
    default ZMK_DISPLAY_WORK_QUEUE_DEDICATED
endchoice

choice ZMK_DISPLAY_STATUS_SCREEN
    default ZMK_DISPLAY_STATUS_SCREEN_CUSTOM
endchoice

config LV_Z_MEM_POOL_SIZE
    default 4096 if ZMK_DISPLAY_STATUS_SCREEN_CUSTOM

config ZMK_DISPLAY_STATUS_SCREEN_CUSTOM
    imply NICE_VIEW_WIDGET_STATUS

config NICE_OLED_GEM_ANIMATION_WPM_FIXED_RANGE
    bool "Enable fixed range for WPM gauge/chart"
    default y

config NICE_OLED_GEM_ANIMATION_WPM_FIXED_RANGE_MAX
    int "Fixed range maximum for WPM gauge/chart"
    default 100

config NICE_OLED_GEM_ANIMATION
    bool "Enable animation on peripheral"
    default y

config NICE_OLED_GEM_ANIMATION_MS
    int "Animation length in milliseconds"
    default 960

config NICE_OLED_POKEMON_ANIMATION
    bool "Enable animation on peripheral"
    default n

config NICE_OLED_POKEMON_ANIMATION_MS
    int "Animation length in milliseconds"
    default 4800

config NICE_OLED_VIM
    bool "Enable static vim on peripheral"
    default n

config NICE_OLED_VIP_MARCOS
    bool "Enable static vim_marcos on peripheral"
    default n

config NICE_VIEW_WIDGET_STATUS
    select LV_USE_LABEL
    select LV_USE_IMG
    select LV_USE_CANVAS
    select LV_USE_ANIMIMG
    select LV_USE_ANIMATION

config NICE_VIEW_WIDGET_INVERTED
    bool "Invert display colors"

if !ZMK_SPLIT || ZMK_SPLIT_ROLE_CENTRAL

config NICE_VIEW_WIDGET_STATUS
    select ZMK_WPM

endif # !ZMK_SPLIT || ZMK_SPLIT_ROLE_CENTRAL

endif # SHIELD_NICE_OLED
```

## config/west.yml
```yaml
manifest:
  remotes:
    - name: zmkfirmware
      url-base: https://github.com/zmkfirmware
    # Additional modules containing boards/shields/custom code can be listed here as well
    # See https://docs.zephyrproject.org/3.2.0/develop/west/manifest.html#projects
    - name: Badjau
      url-base: https://github.com/Badjau
  projects:
    - name: zmk
      remote: zmkfirmware
      revision: main
      import: app/west.yml
    # - name: zmk-nice-oled
    #   remote: Badjau
    #   revision: main
  self:
    path: config
```
