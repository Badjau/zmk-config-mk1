/* ========================================
FileName: dog.c
Date: 15:40 05.September.2022
Author: Marcos Ivan Chow Castro @mctechnology17
Email: mctechnology170318@gmail.com
GitHub: https://github.com/mctechnology17
Brief: QMK oled animations dog_cat
===========================================
                           ╔═╦═╦═╗
                    ╔════╗ ║║║║║╔╝
                    ║╔╗╔╗║ ║║║║║╚╗
                    ╚╝║║╚╝ ║╠═╩╩═╝
                      ║╠═╦═╣╚╦═╦╦═╦╗╔═╦═╦╦╗
                      ║║╩╣═╣║║║║║╬║╚╣╬║╬║║║
                      ╚╩═╩═╩╩╩╩═╩═╩═╩═╬╗╠╗║
                                      ╚═╩═╝

Copyright 2022 Marcos Ivan Chow Castro @mctechnology17
This program is free software: you can redistribute it and/or modify
it under the terms of the GNU General Public License as published by
the Free Software Foundation, either version 2 of the License, or
(at your option) any later version.

This program is distributed in the hope that it will be useful,
but WITHOUT ANY WARRANTY; without even the implied warranty of
MERCHANTABILITY or FITNESS FOR A PARTICULAR PURPOSE.  See the
GNU General Public License for more details.

You should have received a copy of the GNU General Public License
along with this program.  If not, see <http://www.gnu.org/licenses/>.
*/
// INCLUDE {{{
#include "dog.h"
#include "quantum.h"

uint8_t current_wpm_dog =
    0;                   // NOTE: 3. current_wpm to current_wpm_dog parte como 0
led_t led_usb_state_dog; // NOTE: 2. led_usb_state to led_usb_state_dog
uint32_t anim_dog_timer;
uint8_t current_dog_frame = 0; // current dog frame
bool showedJump_dog = true;    // NOTE: 4. showedJump to showedJump_dog
bool isJumping_dog = false;    // NOTE: 5. isJumping to isJumping_dog
uint32_t anim_dog_sleep;
//}}}
// ### FRAMES {{{
void render_dog(int DOG_X, int DOG_Y) { // esta funcion contiene los frames y
                                        // logica de la animacion del perro

  static const char PROGMEM sit[2][ANIM_SIZE_DOG] = {
      // frames de sit
      {
          // 'sit1' 32x22px
          0x00, 0x00, 0x00, 0x00, 0x00, 0x00, 0x00, 0x00, 0x00, 0x00, 0x00,
          0x00, 0x00, 0x00, 0xe0, 0x1c, 0x02, 0x05, 0x02, 0x24, 0x04, 0x04,
          0x02, 0xa9, 0x1e, 0xe0, 0x00, 0x00, 0x00, 0x00, 0x00, 0x00, 0x00,
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          0x00, 0x00, 0x00, 0x00, 0x00, 0x00, 0x00, 0x00,
      },

      {// 'sit2' 32x22px
       0x00, 0x00, 0x00, 0x00, 0x00, 0x00, 0x00, 0x00, 0x00, 0x00, 0x00, 0x00,
       0x00, 0x00, 0xe0, 0x1c, 0x02, 0x05, 0x02, 0x24, 0x04, 0x04, 0x02, 0xa9,
       0x1e, 0xe0, 0x00, 0x00, 0x00, 0x00, 0x00, 0x00, 0x00, 0x00, 0x00, 0x00,
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       0x3e, 0x0f, 0x11, 0x1f, 0x00, 0x00, 0x00, 0x00, 0x00, 0x00, 0x00, 0x00}};

  static const char PROGMEM walk[2][ANIM_SIZE_DOG] = {
      // frames de walk
      {
          // 'walk1' 32x22px
          0x00, 0x00, 0x00, 0x00, 0x00, 0x80, 0x40, 0x20, 0x10, 0x90, 0x90,
          0x90, 0xa0, 0xc0, 0x80, 0x80, 0x80, 0x70, 0x08, 0x14, 0x08, 0x90,
          0x10, 0x10, 0x08, 0xa4, 0x78, 0x80, 0x00, 0x00, 0x00, 0x00, 0x00,
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          0x01, 0x00, 0x00, 0x00, 0x00, 0x00, 0x00, 0x00,
      },

      {
          // 'walk2' 32x22px
          0x00, 0x00, 0x00, 0x00, 0x00, 0x00, 0x80, 0x40, 0x20, 0x20, 0x20,
          0x40, 0x80, 0x00, 0x00, 0x00, 0x00, 0xe0, 0x10, 0x28, 0x10, 0x20,
          0x20, 0x20, 0x10, 0x48, 0xf0, 0x00, 0x00, 0x00, 0x00, 0x00, 0x00,
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          0x01, 0x00, 0x00, 0x00, 0x00, 0x00, 0x00, 0x00,
      }};

  static const char PROGMEM run[2][ANIM_SIZE_DOG] = {
      // frames de run
      {
          // 'run1' 32x22px
          0x00, 0x00, 0x00, 0x00, 0xe0, 0x10, 0x08, 0x08, 0xc8, 0xb0, 0x80,
          0x80, 0x80, 0x80, 0x80, 0x80, 0x80, 0x40, 0x40, 0x3c, 0x14, 0x04,
          0x08, 0x90, 0x18, 0x04, 0x08, 0xb0, 0x40, 0x80, 0x00, 0x00, 0x00,
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          0x04, 0x05, 0x06, 0x00, 0x00, 0x00, 0x00, 0x00,
      },

      {
          // 'run2' 32x22px
          0x00, 0x00, 0x00, 0xe0, 0x10, 0x10, 0xf0, 0x00, 0x00, 0x00, 0x00,
          0x00, 0x00, 0x00, 0x00, 0x80, 0x80, 0x80, 0x78, 0x28, 0x08, 0x10,
          0x20, 0x30, 0x08, 0x10, 0x20, 0x40, 0x80, 0x00, 0x00, 0x00, 0x00,
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          0x01, 0x00, 0x00, 0x00, 0x00, 0x00, 0x00, 0x00,
      }};

  static const char PROGMEM bark[2][ANIM_SIZE_DOG] = {
      // frames de bark
      {
          // 'bark1' 32x22px
          0x00, 0xc0, 0x20, 0x10, 0xd0, 0x30, 0x00, 0x00, 0x00, 0x00, 0x00,
          0x00, 0x00, 0x80, 0x80, 0x40, 0x3c, 0x14, 0x04, 0x08, 0x90, 0x18,
          0x04, 0x08, 0xb0, 0x40, 0x80, 0x00, 0x00, 0x00, 0x00, 0x00, 0x00,
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          0x06, 0x00, 0x00, 0x00, 0x00, 0x00, 0x00, 0x00,
      },

      {
          // 'bark2' 32x22px
          0x00, 0xe0, 0x10, 0x10, 0xf0, 0x00, 0x00, 0x00, 0x00, 0x00, 0x00,
          0x00, 0x00, 0x80, 0x80, 0x40, 0x40, 0x2c, 0x14, 0x04, 0x08, 0x90,
          0x18, 0x04, 0x08, 0xb0, 0x40, 0x80, 0x00, 0x00, 0x00, 0x00, 0x00,
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          0x06, 0x00, 0x00, 0x00, 0x00, 0x00, 0x00, 0x00,
      }};

  static const char PROGMEM sneak[2][ANIM_SIZE_DOG] = {
      // frames de sneak
      {
          // 'sneak1' 32x22px
          0x00, 0x00, 0x00, 0x00, 0x00, 0x00, 0x80, 0x40, 0x40, 0x40, 0x40,
          0x80, 0x00, 0x00, 0x00, 0x00, 0x00, 0x00, 0xc0, 0x40, 0x40, 0x80,
          0x00, 0x80, 0x40, 0x80, 0x00, 0x00, 0x00, 0x00, 0x00, 0x00, 0x00,
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          0x04, 0x02, 0x02, 0x01, 0x00, 0x00, 0x00, 0x00,
      },

      {
          // 'sneak2' 32x22px
          0x00, 0x00, 0x00, 0x00, 0x00, 0x00, 0x80, 0x40, 0x40, 0x40, 0x80,
          0x00, 0x00, 0x00, 0x00, 0x00, 0x00, 0x00, 0xe0, 0xa0, 0x20, 0x40,
          0x80, 0xc0, 0x20, 0x40, 0x80, 0x00, 0x00, 0x00, 0x00, 0x00, 0x00,
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          0x02, 0x01, 0x01, 0x00, 0x00, 0x00, 0x00, 0x00,
      }};

  // matrix }}}
  // ### LOGIC {{{
  void animate_dog(void) { // logica de la animacion del perro

    if (isJumping_dog ||
        !showedJump_dog) { // si isJumping_dog = true o showedJump_dog = false

      oled_set_cursor(DOG_X, DOG_Y + 2);
      oled_write("     ", false);

      oled_set_cursor(DOG_X, DOG_Y - 1);

      showedJump_dog = true;

    } else { // si isJumping_dog = true y showedJump_dog = true

      oled_set_cursor(DOG_X, DOG_Y - 1);
      oled_write("     ", false);

      oled_set_cursor(DOG_X, DOG_Y);
    }

    // cada accion del perro (sit, walk, run, bark y sneak) tiene 2 frames
    current_dog_frame = (current_dog_frame + 1) %
                        2; // con esta formula current_dog_frame toma los
                           // valores 1 y 0 los cuales se van turnando

    if (led_usb_state_dog.caps_lock) { // si esta activado Caps Lock
      oled_write_raw_P(bark[abs(1 - current_dog_frame)],
                       ANIM_SIZE_DOG); // perro ladra

    } else if ((keyboard_report->mods & MOD_BIT(KC_LSFT)) ||
               (keyboard_report->mods &
                MOD_BIT(KC_RSFT))) { // KC_LSFT o KC_RSFT presionado
      oled_write_raw_P(sneak[abs(1 - current_dog_frame)],
                       ANIM_SIZE_DOG); // perro en sneaking

    } else if ((keyboard_report->mods & MOD_BIT(KC_LCTL)) ||
               (keyboard_report->mods &
                MOD_BIT(KC_RCTL))) { // KC_LCTL o KC_RCTL presionado
      oled_write_raw_P(walk[abs(1 - current_dog_frame)],
                       ANIM_SIZE_DOG); // perro camina

    } else if (keyboard_report->mods & MOD_BIT(KC_LGUI)) { // KC_LGUI presionado
      oled_write_raw_P(run[abs(1 - current_dog_frame)],
                       ANIM_SIZE_DOG); // perro corre

      // NOTE: version mejorda perro corre current_wpm_dog
    } else if ((current_wpm_dog > 10) && (current_wpm_dog < 30)) {
      oled_write_raw_P(walk[abs(1 - current_dog_frame)],
                       ANIM_SIZE_DOG); // perro camina

    } else if (current_wpm_dog >= 30) {
      oled_write_raw_P(run[abs(1 - current_dog_frame)],
                       ANIM_SIZE_DOG); // perro corre

    } else { // si no se cumple ninguna de las condiciones anteriores
      oled_write_raw_P(sit[abs(1 - current_dog_frame)],
                       ANIM_SIZE_DOG); // perro se sienta
    }
  }

  if (timer_elapsed32(anim_dog_timer) > ANIM_FRAME_DURATION_DOG) {
    anim_dog_timer = timer_read32();
    animate_dog();

    if (current_wpm_dog != 0) {
      anim_dog_sleep = timer_read32();
    }
  }
}
// }}}
// vim: set fdm=marker:
