#include <dt-bindings/zmk/matrix_transform.h>

/ {
    chosen {
        zephyr,display = &oled;
        zmk,kscan = &kscan0;
        zmk.matrix_transform = &default_transform;
    };

    default_transform: matrix_transform {
        compatible = "zmk,matrix-transform";
        columns = <12>;
        rows = <4>;

        map = <
            RC(0,0) 
        >;
    };

    kscan0: kscan {
        compatible = "zmk,kscan-gpio-matrix";
        label = "KSCAN";
        diode-direction = "col2row";
        wakeup-source;

        // Define placeholders for rows and columns.
        row-gpios = <>;
        col-gpios = <>;
    };
};
