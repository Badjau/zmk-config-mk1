#include "mk1.dtsi"

&default_transform {
    col-offset = <6>;
};

&kscan0 {
    row-gpios = <&pro_micro 10 (GPIO_ACTIVE_HIGH | GPIO_PULL_DOWN)>;

    col-gpios = <&pro_micro 16 (GPIO_ACTIVE_HIGH)>;
};    

&pro_micro_i2c {
    status = "okay";

    oled: ssd1306@3c {
        compatible = "solomon,ssd1306fb";
        reg = <0x3c>;
        label = "DISPLAY";
        width = <128>;
        height = <32>;
        segment-offset = <0>;
        page-offset = <0>;
        display-offset = <0>;
        multiplex-ratio = <31>;
        com-sequential;
        prechargep = <0x22>;
        inversion-on;
    };
};